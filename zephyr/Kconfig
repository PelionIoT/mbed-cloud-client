## zephyr/Kconfig
```kconfig
# Copyright (c) 2021 Pelion.
# Copyright (c) 2022 Izuma Networks
# SPDX-License-Identifier: Apache-2.0

menuconfig IZUMA_CLIENT
    bool "Izuma Device Management Client Library"

    depends on NEWLIB_LIBC
    depends on CPLUSPLUS
    depends on LIB_CPLUSPLUS

    select REBOOT
    select MPU_ALLOW_FLASH_WRITE
    select IZUMA_SOURCES

if IZUMA_CLIENT

config IZUMA_SOURCES
    bool "Build Izuma client from sources"
    help
      Build Izuma client from sources.

config APP_LINK_WITH_IZUMA_CLIENT
    bool "Link application with Izuma client"
    depends on IZUMA_SOURCES
    default y
    help
      Request Zephyr to link the Izuma client library with the application.

if IZUMA_SOURCES
rsource "Kconfig.client"
rsource "Kconfig.mbedtls"
rsource "Kconfig.pal"
endif

endif
```

## zephyr/Kconfig.client
```kconfig
# Copyright (c) 2022 Izuma Networks
# SPDX-License-Identifier: Apache-2.0

config IZUMA_ENDPOINT_TYPE
    string "Endpoint type name"
    default "default"
    help
      Optional name for the type of endpoint being connected. Useful for
      creating filters and organizing devices.

config IZUMA_LIFETIME
    int "Registration lifetime"
    range 60 4294967295
    default 86400
    help
      Interval in seconds between registration renewals. A device transitions
      from state "Registered" to "Deregistered" if the registration is not
      renewed within this lifetime interval. Recommended lifetime settings
      are in the range of multiple hours and days.

choice
    prompt "Transport mode (TCP/UDP/UDP Queue)"
    default IZUMA_TRANSPORT_MODE_UDP
    help
      Select transport protocol and mode: TCP, UDP, or UDP Queue

    config IZUMA_TRANSPORT_MODE_TCP
        bool "TCP"
        help
          Data is sent over TCP. Device actively listens for incoming messages.
          Recommended for applications that are always connected.

    config IZUMA_TRANSPORT_MODE_UDP
        bool "UDP"
        help
          Data is sent over UDP. Device actively listens for incoming messages.
          Recommended for low-bandwidth applications.

    config IZUMA_TRANSPORT_MODE_UDP_QUEUE
        bool "UDP Queue"
        help
          Data is sent over UDP. Messages sent to the device are queued up in
          the Cloud and only delivered immediately after the device renews
          its registration. Recommended for low-power, low-bandwidth
          applications that power downs between transmissions.

endchoice

config IZUMA_EVENT_LOOP_THREAD_STACK_SIZE
    int "Event loop thread stack size"
    default 8192
    help
      Stack size for the event loop thread.

config IZUMA_COAP_MAX_BLOCKWISE_PAYLOAD_SIZE
    int "Max CoAP blockwise payload size"
    default 512
    help
      Maximum payload size used by CoAP.

config IZUMA_DEBUG_TRACE
    bool "Build Izuma DM client with debug tracing"
    help
      Use debug tracing to observe Izuma DM client's internal workings.

config IZUMA_UPDATE
    bool "Enable firmware update"
    default y
    select BOOTLOADER_MCUBOOT
    select REBOOT
    help
      Build Izuma DM Client with support for firmware update.

if IZUMA_UPDATE

    config IZUMA_UPDATE_PERMANENT
        bool "Instruct MCUboot to perform a permanent update instead of a test"
        help
          Marking new firmware as permanent is useful during the development phase
          where applications evolve rapidly.

    config IZUMA_UPDATE_BUFFER
        int "Download buffer size for firmware updates"
        default 1024
        help
          Buffer used for downloading and processing firmware. Must be divisible
          by 2.

    config IZUMA_UPDATE_PAGE_SIZE
        int "Page size for the candidate firmware image's storage medium"
        default 8
        help
          Smallest write granularity supported by the underlying storage medium.
          This value is used at compile time to ensure buffers are correctly aligned.

    config IZUMA_UPDATE_DEVELOPER
        bool "Automatically populate developer update credentials in secure storage"
        help
          For development purposes, the manifest creation tool can generate
          credentials useful during development (not production). Select this
          option for automatic insertion into the credential manager and add
          update_default_resources.c generated by the manifest tool to the build.

endif
```

## zephyr/Kconfig.mbedtls
```kconfig
# Copyright (c) 2021 Pelion.
# SPDX-License-Identifier: Apache-2.0

menu "Mbed TLS options"

config IZUMA_MBEDTLS_FILE
    bool "Built-in Mbed TLS, configuration from file"
    select MBEDTLS

if IZUMA_MBEDTLS_FILE
    config MBEDTLS_CFG_FILE
        string "Use built-in Mbed TLS with configuration file"
        default "config-tls-pelion.h" if IZUMA_MBEDTLS_FILE
endif

config IZUMA_MBEDTLS_LIB_NAME
    string
    default "mbedTLS" if MBEDTLS
    help
      This option allows to specify one or more mbedtls library files to be
      linked with Izuma DM. Separate multiple values with space " ".

endmenu
```

## zephyr/Kconfig.pal
```kconfig
# Copyright (c) 2021 Pelion IoT
# SPDX-License-Identifier: Apache-2.0

menu "Platform Abstraction Layer options"

config PELION_PAL_SUPPORT_NAT64
    bool "Automatic NAT64 address support on IPv6 networks"
    default y
    help
      Help IPv6 devices behind NAT64 use public DNS servers by converting
      IPv4 addresses to IPv6 using default NAT64 prefix. Only comes into
      effect when an IPv6-only device receives an IPv4 address from the DNS
      server.

config PELION_PAL_SUPPORT_SSL_CONNECTION_ID
    bool "Use Connection Identifiers for DTLS 1.2"
    help
      Connection ID is an extention to DTLS 1.2 that allows a DTLS session
      to persist even if the device's IP address and port changes, which
      otherwise would require a new DTLS handshake. This enables devices
      to power down their network interface for long periods of time,
      saving power and network bandwidth.

      Requires mbed TLS 2.18.0 or newer and transport mode to be UDP or
      UDP Queue.

      https://tools.ietf.org/html/draft-ietf-tls-dtls-connection-id-11

config PELION_PAL_USE_APPLICATION_REBOOT
    bool "Use reboot function provided by application"
    help
      Override default reboot function with one provided by application.
      Useful for shutting down the device gracefully, powering down external
      components and saving state.

      Signature for C function:
        void pal_plat_osApplicationReboot(void)

config PELION_PAL_USE_APPLICATION_NETWORK_CALLBACK
    bool "Use network status callback provided by application"
    help
      Provide setter for registering network status callback function in
      application. Application uses callback function to notify Pelion client
      about changes in network connectivity, enabling the client to refrain
      from sending data during network loss.

      Signature for C function:
      #include "pal.h"
      palStatus_t pal_plat_setConnectionStatusCallback(uint32_t interfaceIndex,
                                                       connectionStatusCallback callback,
                                                       void *client_arg)

choice
    prompt "DNS API"
    default PELION_PAL_USE_DNS_API_RESOLVE
    help
      Select DNS API used by network abstraction implementation.

    config PELION_PAL_USE_DNS_API_POSIX
        bool "POSIX"
        help
          Use POSIX's getaddrinfo. This call is synchronous and maps to
          Pelion's DNS version 0.

    config PELION_PAL_USE_DNS_API_RESOLVE
        bool "DNS Resolve"
        depends on DNS_RESOLVER
        help
          Use DNS Resolve's dns_get_addr_info. This call is asynchronous and maps
          to Pelion's DNS version 3.

endchoice

config NEWLIB_LIBC_FLOAT_PRINTF
    bool "Build with newlib float printf"
    default y
    help
      Enable floating points in Newlib's snprintf. Must be enabled for correctly
      formatting floating points in LwM2M resources.

endmenu
```
